## conf/machine/blackparrot.conf
```bitbake
#@TYPE: Machine
#@NAME: BlackParrot test machine
#@DESCRIPTION: Machine configuration for BlackParrot testing

require conf/machine/include/riscv/qemuriscv.inc

XVISOR_PLAT = "riscv/virt64"

# No compression extension, please
TUNE_CCARGS = "-march=rv64imafdc -mabi=lp64d"

PREFERRED_PROVIDER_virtual/kernel ?= "linux-stable"
PREFERRED_VERSION_linux-stable ?= "5.15.24"

EXTRA_IMAGEDEPENDS += "opensbi"
KERNEL_DEVICETREE = "blackparrot/bp-1hart.dtb"
RISCV_SBI_PLAT = "blackparrot"
RISCV_SBI_FDT = "bp-1hart.dtb"
RISCV_SBI_PAYLOAD = "Image"

# First boot takes forever to generate an RSA host key, which is not fun
PACKAGE_EXCLUDE = "openssh ssh packagegroup-core-ssh-openssh"
```
